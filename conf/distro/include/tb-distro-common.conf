## conf/distro/include/tb-distro-common.conf
```bitbake
require conf/distro/poky.conf

DISTRO_NAME = "Zarhus distro for demonstration purposes of TrenchBoot project"
DISTRO_VERSION = "0.5.0"
SDK_VENDOR = "-tbsdk"

MAINTAINER = "3mdeb Sp. z o. o. <contact@3mdeb.com>"

TARGET_VENDOR = "-tb"

DISTRO_FEATURES = " \
    ext2 \
    keyboard \
    largefile \
    ldconfig \
    nfs \
    pci \
    systemd \
    usbgadget \
    usbhost \
    tpm2 \
    usrmerge \
"

# set content of boot partition
IMAGE_EFI_BOOT_FILES = " \
    skl.bin \
    acm/*;acm/ \
"

# adds initramfs image to handle label option from grub.cfg
INITRAMFS_IMAGE = "core-image-initramfs-boot"
INITRAMFS_IMAGE_BUNDLE = "1"

# wks related variables
WKS_FILES = "trenchboot-image-efipluslegacy.wks.in"
WKS_FILE_DEPENDS:append = " grub-native"

# explicitly use systemd and disable sysvinit completely
VIRTUAL-RUNTIME_init_manager = "systemd"
VIRTUAL-RUNTIME_initscripts = ""
VIRTUAL-RUNTIME_syslog = ""
DISTRO_FEATURES_BACKFILL_CONSIDERED += "sysvinit"

# use TrenchBoot Linux and GRUB
PREFERRED_PROVIDER_virtual/kernel = "linux-tb"
PREFERRED_PROVIDER_bootloader/kernel = "grub"
PREFERRED_VERSION_linux-tb ?= "6.13%"
```

## conf/distro/tb-xen-distro.conf
```bitbake
require conf/distro/include/tb-distro-common.conf

DISTRO = "tb-xen-distro"
DISTRO_FEATURES += "virtualization xen"

IMAGE_EFI_BOOT_FILES += " \
    xen-${MACHINE};xen \
    xen-${MACHINE}.efi;xen.efi \
    xen.cfg \
"

PREFERRED_VERSION_xen = "4.17+tb"
# TODO: for some reason, building tools from TB fork does not build all of the
# tools - many basic binaries are missing
PREFERRED_VERSION_xen-tools = "4.17+stable"

TB_GRUB_CFG_FILE = "grub-full.cfg"
```

## conf/layer.conf
```bitbake
# We have a conf and classes directory, add to BBPATH
BBPATH .= ":${LAYERDIR}"

BBFILES += " \
    ${LAYERDIR}/recipes-*/*/*.bb \
    ${LAYERDIR}/recipes-*/*/*.bbappend \
"

BBFILES_DYNAMIC += " \
    virtualization-layer:${LAYERDIR}/dynamic-layers/virtualization-layer/*/*/*.bb \
    virtualization-layer:${LAYERDIR}/dynamic-layers/virtualization-layer/*/*/*.bbappend \
"

BBFILE_COLLECTIONS += "meta-trenchboot"
BBFILE_PATTERN_meta-trenchboot = "^${LAYERDIR}/"
BBFILE_PRIORITY_meta-trenchboot = "6"

LAYERDEPENDS_meta-trenchboot = "core openembedded-layer"
LAYERSERIES_COMPAT_meta-trenchboot = "scarthgap"
```
